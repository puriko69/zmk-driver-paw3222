## Kconfig
```kconfig
menuconfig PAW3222
    bool "PAW3222 mouse optical sensor"
  select SPI
    help
      Enable PAW3222 mouse optical sensor.

enum paw32xx_rotation {
	PAW32XX_ROTATION_0 = 0,
	PAW32XX_ROTATION_90,
	PAW32XX_ROTATION_180,
	PAW32XX_ROTATION_270,
};
```

## dts/bindings/pixart,paw3222.yaml
```yaml
# Copyright 2024 Google LLC
# Copyright 2025 sekigon-gonnoc
# SPDX-License-Identifier: Apache-2.0

description: PAW32xx ultra low power wireless mouse chip

compatible: "pixart,paw3222"

include: spi-device.yaml

properties:
  irq-gpios:
    type: phandle-array
    required: true
    description:
      GPIO connected to the motion pin, active low.

  power-gpios:
    type: phandle-array
    required: false
    description:
      GPIO connected to the power control pin.

  res-cpi:
    type: int
    description: |
      CPI resolution for the sensor. This can also be changed in runtime using
      the paw32xx_set_resolution() API.

  force-awake:
    type: boolean
    description: |
      Initialize the sensor in "force awake" mode. This can also be enabled or
      disabled in runtime by the application using the paw32xx_force_awake()
      API.
      
  rotation:  # ← ★ここを追加
    type: int
    required: false
    enum: [0, 90, 180, 270]
    description: |
      Sensor rotation in degrees (clockwise).
      - 0: Default orientation
      - 90: Rotated 90 degrees
      - 180: Rotated 180 degrees
      - 270: Rotated 270 degrees

  scroll-layers:
    type: array
    required: false
    description: |
      Layers on which scrolling is active
```
